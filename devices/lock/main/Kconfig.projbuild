## devices/lock/main/Kconfig.projbuild
```kconfig
menu "HACKLAND Lock Configuration"

config WIFI_SSID
    string "WiFi SSID"
    default "myssid"
    help
        SSID (network name) for the example to connect to.

config WIFI_PASSWORD
    string "WiFi Password"
    default "mypassword"
    help
        WiFi password (WPA or WPA2) for the example to use.

config BROKER_URL
    string "Broker URL"
    default "mqtt://192.168.0.12"
    help
        URL of the broker to connect to

config UNLOCK_PIN_GPIO
    int "Unlock pin GPIO"
    default 4
    help
        The Pin to use for the unlock relay.
        Default = GPIO_04 = D2 

config UNLOCK_BUTTON_GPIO
    int "Unlock button"
    default 5
    help
        The pin for the unlock button.  This is the button that is inside and will always open the door.   
        Default = GPIO_05 = D1 


endmenu
```
